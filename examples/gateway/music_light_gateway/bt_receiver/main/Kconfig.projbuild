## examples/gateway/music_light_gateway/bt_receiver/main/Kconfig.projbuild
```kconfig
menu "Bluetooth receiver"

    config BT_RX_DEVICE_NAME
        string "Bluetooth name"
        default "Music Light"
        help
            The name phones show when pairing.

    config BT_RX_I2S_BCLK_GPIO
        int "I2S BCLK GPIO"
        default 26
        help
            Goes to the amplifier BCLK and to the gateway's Bluetooth BCLK input.

    config BT_RX_I2S_WS_GPIO
        int "I2S WS (LRCLK) GPIO"
        default 25

    config BT_RX_I2S_DOUT_GPIO
        int "I2S data out GPIO"
        default 22

    config BT_RX_UART_TX_GPIO
        int "UART TX GPIO (to the gateway RX)"
        default 17

    config BT_RX_UART_RX_GPIO
        int "UART RX GPIO (from the gateway TX)"
        default 16

endmenu
```

## examples/gateway/music_light_gateway/main/Kconfig.projbuild
```kconfig
menu "Music Light Gateway"

    menu "Wi-Fi"
        config GATEWAY_WIFI_SSID
            string "Wi-Fi SSID"
            default "myssid"
            help
                SSID of the access point the gateway connects to.

        config GATEWAY_WIFI_PASSWORD
            string "Wi-Fi Password"
            default "mypassword"
            help
                Password of the access point. Leave empty for an open network.

        config GATEWAY_WIFI_MAX_RETRY_INTERVAL_MS
            int "Max reconnect interval (ms)"
            default 30000
            range 1000 600000
            help
                The reconnect delay doubles after each failed attempt, up to this value.
    endmenu

    menu "MQTT"
        config GATEWAY_MQTT_BROKER_URI
            string "Broker URI"
            default "mqtt://broker.emqx.io:1883"
            help
                URI of the MQTT broker, e.g. mqtt://host:1883 or mqtts://host:8883.

        config GATEWAY_MQTT_USERNAME
            string "Username"
            default ""

        config GATEWAY_MQTT_PASSWORD
            string "Password"
            default ""

        config GATEWAY_MQTT_TOPIC_PREFIX
            string "Topic prefix"
            default "music-light"
            help
                All topics are built as <prefix>/<gateway_id>/<suffix>.
                The gateway id is derived from the station MAC address.

        config GATEWAY_TELEMETRY_INTERVAL_S
            int "Telemetry interval (s)"
            default 30
            range 5 3600
            help
                Interval for publishing gateway telemetry (uptime, heap, RSSI).
    endmenu

    menu "Microphone"
        config AUDIO_I2S_BCLK_GPIO
            int "I2S BCLK (SCK) GPIO"
            default 4

        config AUDIO_I2S_WS_GPIO
            int "I2S WS (LRCLK) GPIO"
            default 5

        config AUDIO_I2S_DIN_GPIO
            int "I2S data in (SD) GPIO"
            default 6

        config AUDIO_MIC_SLOT_RIGHT
            bool "Microphone outputs on the right slot (L/R pin high)"
            default n

        config AUDIO_SAMPLE_RATE
            int "Sample rate (Hz)"
            default 16000
            range 8000 48000
            help
                16 kHz covers the bands used for beat and mood analysis.

        config AUDIO_SILENCE_DB
            int "Silence threshold (dBFS)"
            default -65
            range -90 -10
            help
                Sound quieter than this is treated as silence and the light
                falls back to a dim idle breathing effect. With a typical MEMS mic
                (-26 dBFS at 94 dB SPL) music at 60-80 dB SPL arrives at about
                -60..-40 dBFS and a quiet room at -80 dBFS or below. Raise it in
                noisy rooms; check the level_db value in the /music messages.
    endmenu

    menu "RGBW light"
        config LIGHT_R_GPIO
            int "Red PWM GPIO"
            default 38

        config LIGHT_G_GPIO
            int "Green PWM GPIO"
            default 39

        config LIGHT_B_GPIO
            int "Blue PWM GPIO"
            default 40

        config LIGHT_W_GPIO
            int "White PWM GPIO"
            default 41

        config LIGHT_ACTIVE_HIGH
            bool "Driver dim input is active high"
            default y

        config LIGHT_PWM_FREQ_HZ
            int "PWM frequency (Hz)"
            default 19500
            range 500 19500
            help
                Above the audible range so the driver and LEDs do not whine.
                Duty resolution is fixed at 12 bits, which limits this to 19.5 kHz.

        config LIGHT_MAX_POWER_PERCENT
            int "Max duty per channel (%)"
            default 100
            range 5 100
            help
                Caps every channel to stay within the thermal budget of the board.
    endmenu

    menu "Round touch display"
        config DISPLAY_ENABLE
            bool "Enable the round touch display"
            default y
            help
                ST77916 360x360 QSPI LCD with a CST816S touch controller, showing the
                current mood, BPM and light color, with touch control of mode and brightness.

        if DISPLAY_ENABLE
            config DISPLAY_QSPI_CS_GPIO
                int "LCD CS GPIO"
                default 10

            config DISPLAY_QSPI_CLK_GPIO
                int "LCD CLK GPIO"
                default 12

            config DISPLAY_QSPI_D0_GPIO
                int "LCD D0 GPIO"
                default 11

            config DISPLAY_QSPI_D1_GPIO
                int "LCD D1 GPIO"
                default 13

            config DISPLAY_QSPI_D2_GPIO
                int "LCD D2 GPIO"
                default 14

            config DISPLAY_QSPI_D3_GPIO
                int "LCD D3 GPIO"
                default 9

            config DISPLAY_RST_GPIO
                int "LCD reset GPIO (-1 if not connected)"
                default 8
                range -1 48

            config DISPLAY_BACKLIGHT_GPIO
                int "Backlight GPIO (-1 if always on)"
                default 7
                range -1 48

            config DISPLAY_BACKLIGHT_ACTIVE_HIGH
                bool "Backlight is on when GPIO is high"
                default y

            config DISPLAY_TOUCH_SDA_GPIO
                int "Touch SDA GPIO"
                default 15

            config DISPLAY_TOUCH_SCL_GPIO
                int "Touch SCL GPIO"
                default 16

            config DISPLAY_TOUCH_INT_GPIO
                int "Touch INT GPIO (-1 if not connected)"
                default 17
                range -1 48

            config DISPLAY_TOUCH_RST_GPIO
                int "Touch reset GPIO (-1 if not connected)"
                default 18
                range -1 48

            config DISPLAY_MIRROR_X
                bool "Mirror the touch X axis"
                default n

            config DISPLAY_MIRROR_Y
                bool "Mirror the touch Y axis"
                default n
        endif
    endmenu

    menu "Bluetooth light sync"
        config LIGHT_SYNC_ENABLE
            bool "Broadcast the light to satellite lights over Bluetooth LE"
            default y
            depends on BT_NIMBLE_ENABLED
            help
                Sends what the gateway's own LEDs show in non-connectable Bluetooth LE
                advertisements every 20 ms, so any number of satellite lights running
                the sync_light firmware follow the music in step. Needs NimBLE with
                the broadcaster role.

        config LIGHT_SYNC_GROUP
            int "Group"
            default 1
            range 1 255
            depends on LIGHT_SYNC_ENABLE
            help
                Satellites follow only the gateway with the same group, so two
                gateways in neighbouring rooms do not mix.
    endmenu

    menu "Bluetooth receiver board"
        config BT_LINK_ENABLE
            bool "Analyse music from a Bluetooth receiver board"
            default n
            help
                An ESP32 board running the bt_receiver firmware (see bt_receiver/)
                receives music from a phone over Bluetooth and plays it through an
                I2S amplifier. This chip listens on the same I2S wires as a slave,
                so the music is analysed before it reaches the room, and reads the
                connection and track from the board over UART. While the board plays,
                the analysis uses it instead of the microphone.

        if BT_LINK_ENABLE
            config BT_LINK_I2S_BCLK_GPIO
                int "I2S BCLK GPIO (from the board)"
                default 1

            config BT_LINK_I2S_WS_GPIO
                int "I2S WS GPIO (from the board)"
                default 2

            config BT_LINK_I2S_DIN_GPIO
                int "I2S data GPIO (from the board)"
                default 47

            config BT_LINK_UART_NUM
                int "UART port"
                default 1
                range 1 2

            config BT_LINK_UART_TX_GPIO
                int "UART TX GPIO (to the board RX)"
                default 42

            config BT_LINK_UART_RX_GPIO
                int "UART RX GPIO (from the board TX)"
                default 21
        endif
    endmenu

    config GATEWAY_BUTTON_GPIO
        int "Button GPIO (-1 to disable)"
        default 0
        range -1 48
        help
            Single click cycles the light mode (music, static, off), long press (5 s) reboots.

endmenu
```

## examples/gateway/music_light_gateway/sdkconfig.defaults
```kconfig
CONFIG_ESPTOOLPY_FLASHSIZE_4MB=y
CONFIG_MQTT_PROTOCOL_311=y
CONFIG_ESP_MAIN_TASK_STACK_SIZE=4096
CONFIG_PARTITION_TABLE_CUSTOM=y
CONFIG_PARTITION_TABLE_CUSTOM_FILENAME="partitions.csv"
CONFIG_LV_FONT_MONTSERRAT_24=y
CONFIG_LV_USE_CLIB_MALLOC=y
CONFIG_SPIRAM=y
CONFIG_SPIRAM_MODE_OCT=y
CONFIG_SPIRAM_IGNORE_NOTFOUND=y
CONFIG_BT_ENABLED=y
CONFIG_BT_NIMBLE_ENABLED=y
CONFIG_BT_NIMBLE_ROLE_BROADCASTER=y
CONFIG_BT_NIMBLE_ROLE_OBSERVER=n
CONFIG_BT_NIMBLE_ROLE_CENTRAL=n
CONFIG_BT_NIMBLE_ROLE_PERIPHERAL=n
CONFIG_BT_NIMBLE_GATT_CLIENT=n
CONFIG_BT_NIMBLE_GATT_SERVER=n
CONFIG_BT_NIMBLE_SECURITY_ENABLE=n
```

## examples/gateway/music_light_gateway/sync_light/main/Kconfig.projbuild
```kconfig
menu "Sync light"

    config SYNC_GROUP
        int "Group"
        default 1
        range 1 255
        help
            Follow only the gateway broadcasting this group (Bluetooth light sync
            in the gateway's menuconfig).

    config SYNC_R_GPIO
        int "Red PWM GPIO"
        default 4

    config SYNC_G_GPIO
        int "Green PWM GPIO"
        default 5

    config SYNC_B_GPIO
        int "Blue PWM GPIO"
        default 6

    config SYNC_W_GPIO
        int "White PWM GPIO"
        default 7

    config SYNC_ACTIVE_HIGH
        bool "Driver dim input is active high"
        default y

    config SYNC_PWM_FREQ_HZ
        int "PWM frequency (Hz)"
        default 19500
        range 500 19500

    config SYNC_MAX_POWER_PERCENT
        int "Max duty per channel (%)"
        default 100
        range 5 100

    config SYNC_TIMEOUT_MS
        int "Fade out after no packets for (ms)"
        default 3000
        range 500 60000
        help
            When the gateway is off or out of range, the light fades to dark.

endmenu
```

## examples/gateway/wifi_mqtt_gateway/main/Kconfig.projbuild
```kconfig
menu "Gateway Configuration"

    menu "Wi-Fi"
        config GATEWAY_WIFI_SSID
            string "Wi-Fi SSID"
            default "myssid"
            help
                SSID of the access point the gateway connects to.

        config GATEWAY_WIFI_PASSWORD
            string "Wi-Fi Password"
            default "mypassword"
            help
                Password of the access point. Leave empty for an open network.

        config GATEWAY_WIFI_MAX_RETRY_INTERVAL_MS
            int "Max reconnect interval (ms)"
            default 30000
            range 1000 600000
            help
                The reconnect delay doubles after each failed attempt, up to this value.
    endmenu

    menu "MQTT"
        config GATEWAY_MQTT_BROKER_URI
            string "Broker URI"
            default "mqtt://broker.emqx.io:1883"
            help
                URI of the MQTT broker, e.g. mqtt://host:1883 or mqtts://host:8883.

        config GATEWAY_MQTT_USERNAME
            string "Username"
            default ""

        config GATEWAY_MQTT_PASSWORD
            string "Password"
            default ""

        config GATEWAY_MQTT_TOPIC_PREFIX
            string "Topic prefix"
            default "esp-gateway"
            help
                All topics are built as <prefix>/<gateway_id>/<suffix>.
                The gateway id is derived from the station MAC address.

        config GATEWAY_TELEMETRY_INTERVAL_S
            int "Telemetry interval (s)"
            default 30
            range 5 3600
            help
                Interval for publishing gateway telemetry (uptime, heap, RSSI).
    endmenu

    menu "Sub-device UART"
        config GATEWAY_UART_PORT
            int "UART port"
            default 1
            range 0 2

        config GATEWAY_UART_TX_GPIO
            int "UART TX GPIO"
            default 4

        config GATEWAY_UART_RX_GPIO
            int "UART RX GPIO"
            default 5

        config GATEWAY_UART_BAUD_RATE
            int "UART baud rate"
            default 115200

        config GATEWAY_UART_LINE_MAX
            int "Max line length (bytes)"
            default 512
            range 64 4096
            help
                Sub-devices send newline-terminated frames. Longer lines are
                forwarded in chunks of this size.
    endmenu

    menu "Indicator and button"
        config GATEWAY_LED_GPIO
            int "Status LED GPIO (-1 to disable)"
            default 2
            range -1 48

        config GATEWAY_LED_ACTIVE_HIGH
            bool "LED is on when GPIO is high"
            default y

        config GATEWAY_BUTTON_GPIO
            int "Button GPIO (-1 to disable)"
            default 0
            range -1 48
            help
                Single click publishes a button event, long press (5 s) reboots the gateway.

        config GATEWAY_BUTTON_ACTIVE_LEVEL
            int "Button active level"
            default 0
            range 0 1
    endmenu

endmenu
```
